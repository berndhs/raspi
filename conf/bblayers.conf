## conf/bblayers.conf
```bitbake
# POKY_BBLAYERS_CONF_VERSION is increased each time build/conf/bblayers.conf
# changes incompatibly
POKY_BBLAYERS_CONF_VERSION = "2"

BBPATH = "${TOPDIR}"
BBFILES ?= ""

BBLAYERS ?= " \
  /home/bernd/dawork/yocto/poky/meta \
  /home/bernd/dawork/yocto/poky/meta-poky \
  /home/bernd/dawork/yocto/poky/meta-yocto-bsp \
  /home/bernd/dawork/yocto/poky/meta-selftest \
  /home/bernd/dawork/yocto/poky/meta-raspberrypi \
  /home/bernd/dawork/yocto/poky/meta-yocto \
  /home/bernd/dawork/yocto/poky/meta-yocto-bsp \
  /home/bernd/dawork/yocto/poky/meta-poky \
  /home/bernd/dawork/yocto/poky/meta-skeleton \
  /home/bernd/dawork/yocto/poky/meta-qt5 \
  /home/bernd/dawork/yocto/poky/meta-openembedded/meta-efl \
  /home/bernd/dawork/yocto/poky/meta-openembedded/meta-webserver \
  /home/bernd/dawork/yocto/poky/meta-openembedded/meta-gnome \
  /home/bernd/dawork/yocto/poky/meta-openembedded/meta-perl \
  /home/bernd/dawork/yocto/poky/meta-openembedded/meta-systemd \
  /home/bernd/dawork/yocto/poky/meta-openembedded/meta-multimedia \
  /home/bernd/dawork/yocto/poky/meta-openembedded/meta-xfce \
  /home/bernd/dawork/yocto/poky/meta-openembedded/meta-python \
  /home/bernd/dawork/yocto/poky/meta-openembedded/meta-gpe \
  /home/bernd/dawork/yocto/poky/meta-openembedded/meta-initramfs \
  /home/bernd/dawork/yocto/poky/meta-openembedded/meta-ruby \
  /home/bernd/dawork/yocto/poky/meta-openembedded/meta-oe \
  /home/bernd/dawork/yocto/poky/meta-openembedded/meta-filesystems \
  /home/bernd/dawork/yocto/poky/meta-openembedded/meta-networking \
"
```
